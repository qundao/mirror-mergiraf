/{
        compatible = "mergiraf,example", "mergiraf,test";
        interrupt-parent = <&intc>;
        example = "bar";

        chosen { };
        aliases { };

        memory {
                device_type = "memory";
                reg = <0x00000000 0x40000000>;
        };
};
